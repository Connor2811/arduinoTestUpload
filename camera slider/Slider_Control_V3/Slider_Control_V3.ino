
//OLED DISPLAY
#include <SPI.h>
#include <Wire.h>
#include <Adafruit_GFX.h>
#include <Adafruit_SSD1306.h>
#include <EEPROM.h>

#define SCREEN_WIDTH 128 // OLED display width, in pixels
#define SCREEN_HEIGHT 64 // OLED display height, in pixels

// Declaration for an SSD1306 display connected to I2C (SDA, SCL pins)
#define OLED_RESET     -1 // Reset pin # (or -1 if sharing Arduino reset pin)
Adafruit_SSD1306 display(SCREEN_WIDTH, SCREEN_HEIGHT, &Wire, OLED_RESET);
#define LOGO_HEIGHT   64
#define LOGO_WIDTH    128
//char for logo display
static const unsigned char PROGMEM logo_bmp[] =
{ 0x00, 0x00, 0x00, 0x00, 0x00, 0x00, 0x00, 0x00, 0x00, 0x00, 0x00, 0x00, 0x00, 0x00, 0x00, 0x00,
0x00, 0x00, 0x00, 0x00, 0x00, 0x00, 0x00, 0x00, 0x00, 0x00, 0x00, 0x00, 0x00, 0x00, 0x00, 0x00,
0x00, 0x00, 0x00, 0x00, 0x00, 0x00, 0x00, 0x00, 0x00, 0x00, 0x00, 0x00, 0x00, 0x00, 0x00, 0x00,
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0x00, 0x00, 0x00, 0x00, 0x00, 0x00, 0x00, 0x00, 0x00, 0x00, 0x00, 0x00, 0x00, 0x00, 0x00, 0x00
};
  

//ENCODER
 #define outputA 3   //first data input pin for the encoder
 #define outputB 4   //second data input pin for the encoder
 double counter = 0;    //tracks how many clicks the encoder has had
 int aState;         //Value to store the current state of the Encoder
 int aLastState;     //Value to store the last state of the Encoder
 const byte encoderButtonInterruptPin = 2;        //inerupt pin attached to the encoders button  
 const byte encodeRotationrInterruptPin = 3;      //interupt pin attached to the encoders rotation

//STEPPER
#define horizontalDirPin 5        //direction pin for horizontal motor       
#define horizontalStepPin 6       //drive pin for horizontal motor  
#define rotationlDirPin 7         //direction pin for rotation motor
#define rotationStepPin 8         //drive pin for rotation motor
#define disablePin 9              //pin to dissable both stepper drivers

//MENU LOGIC
  int menu = 0;                  //menus are stored as numbers
  #define homeMenuID 0           //numerical ID for all menu options
  #define timeControlID 1
  #define speedControlID 2
  #define motionControlID 3
  #define globalValuesID 4
  #define menuTuneID 100
  int menuOptionCount;           //number of options availible on a given menu

//SUBMENU LOGIC  
  int subMenu;
  #define tuneSubMenuID 0
  #define speedSubMenuID 1
  #define angleSubMenuID 2
  #define secondsSubMenuID 3
  #define minutesSubMenuID 4
  #define hoursSubMenuID 5
  #define directionSubMenuID 6
  #define runSubMenuID 7
  #define returnSubMenuID 8
  #define mainSubMenuID 9
  #define steppersSubMenuID 10
  #define jogSubMenuID 11
  #define lengthSubMenuID 12
  
  
  
  

//EEPROM CONFIGURE


  //Global EEPROM
  long length_Inches = 30;                  //length of the slider rail in inches
  int length_Inches_eeAddress = 0;          //Location of information in eeprom

  long Steps_Per_inch = 2032;
  int Steps_Per_inch_eeAddress = 44;

  
  //speedControl EEPROM
  float speedControl_speed = 50.00;             //speed of the horizontal slider while in speedControl Mode in inches per minute
  int speedControl_speed_eeAddress = 4;     //Location of information in eeprom

  int speedControl_counter = 10;             //speed of the horizontal slider while in speedControl Mode in inches per minute
  int speedControl_counter_eeAddress = 48;     //Location of information in eeprom
  
  long speedControl_rDistance = 0;          //amount in degrees to rotate camera over one slide operation in speed control mode
  int speedControl_rDistance_eeAddress = 8; //Location of information in eeprom


  //timeControl EEPROM 
  unsigned long timeControl_seconds = 30;           //speed of the horizontal slider while in speedControl Mode
  int timeControl_seconds_eeAddress = 28;  //Location of information in eeprom

  unsigned long timeControl_minutes = 0;            //speed of the horizontal slider while in speedControl Mode
  int timeControl_minutes_eeAddress = 32;  //Location of information in eeprom

  unsigned long timeControl_hours = 0;              //speed of the horizontal slider while in speedControl Mode
  int timeControl_hours_eeAddress = 36;    //Location of information in eeprom
  
  long timeControl_rDistance = 0;          //amount in degrees to rotate camera over one slide operation in speed control mode
  int timeControl_rDistance_eeAddress = 40;//Location of information in eeprom


  //motionControl EEPROM
  double motionControl_dAway = 4.;          //Distance of object to be tracked tangent to the rail
  int  motionControl_dAway_eeAddress = 12; //Location of information in eeprom

  double motionControl_dDown= 4.;           //distance of the tracked object from theright side and parallel to the rail
  int  motionControl_dDown_eeAddress = 16; //Location of information in eeprom

  long motionControl_speed= 50;            //speed of the shot
  int  motionControl_speed_eeAddress = 20; //Location of information in eeprom

  long motionControl_time= 50;            //time in seconds to traverse
  int  motionControl_time_eeAddress = 24; //Location of information in eeprom

  
// Stored Values
  float LENGTH = length_Inches * Steps_Per_inch;  //converts length into steps
  String movementDirection = "  left ";            //sets direction of travel, this is flopped after each operation
  int changeValue = false;                       //determines whether to configure the operation values or scroll down a menu, this is flipped by clicking encoder while over value
  int changeCounter = 0;                         // if change value is true "changeCounter" will be changed instead of the normal "counter" value
  int runningPath = false;                       //tracks wether or not an operation is curretly running
  unsigned long currentMicros;
  int negative = false;
  String stepperState = " disabled";

  


void setup() {
//   for (int i = 0 ; i < EEPROM.length() ; i++) {
//    EEPROM.write(i, 0);
 // }





  
  Serial.begin(9600);

//OLED DISPLAY  
  display.clearDisplay();                    //Display Logo
 /*
  display.drawBitmap(
    (display.width()  - LOGO_WIDTH ) / 2,
    (display.height() - LOGO_HEIGHT) / 2,
    logo_bmp, LOGO_WIDTH, LOGO_HEIGHT, 1);
  display.display();
  delay(1000);
    */                                               // SSD1306_SWITCHCAPVCC = generate display voltage from 3.3V internally
  if(!display.begin(SSD1306_SWITCHCAPVCC, 0x3C)) { // Address 0x3D for 128x64
    Serial.println(F("SSD1306 allocation failed"));
    for(;;);                                       // Don't proceed, loop forever
  }
    display.display();
    display.cp437(true);
  
//ENCODER

  pinMode (outputA,INPUT);                          //Sets encoder pins as inputs
  pinMode (outputB,INPUT);
  aLastState = digitalRead(outputA);                //saves encoders current position
  pinMode(encoderButtonInterruptPin, INPUT_PULLUP); //defines encoder button intterupt pin
  attachInterrupt(digitalPinToInterrupt(encoderButtonInterruptPin), clicked, RISING);     //if encoderButtonInterruptPin is rising then stop everything and run clicked()
  attachInterrupt(digitalPinToInterrupt(encodeRotationrInterruptPin), encoder, CHANGE);   //if encodeRotationrInterruptPin has changed stop everything and run encoder()

//STEPPER
  pinMode(horizontalStepPin, OUTPUT);  //defines all the stepper controll pis as outputs
  pinMode(horizontalDirPin, OUTPUT);
  pinMode(rotationStepPin, OUTPUT);
  pinMode(rotationlDirPin, OUTPUT);  
  pinMode(disablePin, OUTPUT);

  digitalWrite(disablePin, HIGH);       //disables all steppers
  
//Menu Initioalization
  menu = homeMenuID;   //set the current screen to homescreen (this is defined again because it was sensing phantom presses on startup)
}

void loop() {
  Serial.println(counter);
//MENU ORGANIZATION 
  //sends the program to the function that matches the current desired screen
  if (menu == homeMenuID){
    mainMenu();
  }
  if (menu == timeControlID){
    menuTimeControl();
  }
  if (menu == speedControlID){
    menuSpeedControl();
  }
  if (menu == motionControlID){
    menuMotionControl();
  }
  if (menu == globalValuesID){
    menuGlobalValues();
  }
  if (menu > menuTuneID){
    menuTune();
  }
}

#define XPOS   0 // Indexes into the 'icons' array in function below
#define YPOS   1
#define DELTAY 2
